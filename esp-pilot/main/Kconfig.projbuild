## esp-pilot/main/Kconfig.projbuild
```kconfig
menu "STM32 ADC Logger"

    config ADC_LOGGER_PIN_RDY
        int "STM32 RDY input GPIO"
        default 10

    config ADC_LOGGER_PIN_CS
        int "SPI CS GPIO"
        default 7

    config ADC_LOGGER_PIN_SCK
        int "SPI SCK GPIO"
        default 4

    config ADC_LOGGER_PIN_MISO
        int "SPI MISO GPIO"
        default 5

    config ADC_LOGGER_PIN_MOSI
        int "SPI MOSI GPIO"
        default 6

    config ADC_LOGGER_SPI_CLOCK_HZ
        int "SPI clock (Hz)"
        range 1000000 12000000
        default 6000000

    config ADC_LOGGER_QUEUE_DEPTH
        int "Packet queue depth"
        range 2 16
        default 16

    config ADC_LOGGER_FILE_BUFFER_BYTES
        int "Recorder stdio buffer size"
        range 4096 65536
        default 65536

    config ADC_LOGGER_FILE_LIST_MAX
        int "Max files returned by web API"
        range 8 64
        default 32

    config ADC_LOGGER_WIFI_AP_SSID
        string "SoftAP SSID"
        default "stm32-adc-logger"

    config ADC_LOGGER_WIFI_AP_PASSWORD
        string "SoftAP password"
        default "pilot1234"
        help
            Set an empty value to use an open network. WPA2 requires at least 8 characters.

    config ADC_LOGGER_WIFI_AP_CHANNEL
        int "SoftAP channel"
        range 1 13
        default 6

endmenu
```

## esp-pilot/sdkconfig.defaults.esp32s3
```kconfig
CONFIG_ESPTOOLPY_FLASHSIZE_16MB=y
CONFIG_ESPTOOLPY_FLASHSIZE="16MB"
CONFIG_ADC_LOGGER_SPI_CLOCK_HZ=6000000
```
